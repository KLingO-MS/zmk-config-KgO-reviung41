## config/west.yml
```yaml
manifest:
  remotes:
    - name: zmkfirmware
      url-base: https://github.com/zmkfirmware
    - name: testing
      url-base: https://github.com/petejohanson
  projects:
    - name: zmk
      remote: zmkfirmware
#      remote: testing
      revision: main
#      revision: zephyr/test-llcp-conn-update-fix
      import: app/west.yml
  self:
    path: config
```
